## examples/02-01-main-led/sdkconfig.defaults
```kconfig
# DNESP32S3 使用 ESP32-S3 芯片。
CONFIG_IDF_TARGET="esp32s3"
# 开发板搭载 16 MB Flash；首次配置工程时以这里的默认值为准。
CONFIG_ESPTOOLPY_FLASHSIZE_16MB=y
```

## examples/03-boot-key-control-led/sdkconfig.defaults
```kconfig
# DNESP32S3 使用 ESP32-S3 芯片。
CONFIG_IDF_TARGET="esp32s3"
# 开发板搭载 16 MB Flash。
CONFIG_ESPTOOLPY_FLASHSIZE_16MB=y
```

## examples/08-task-watchdog/main/Kconfig.projbuild
```kconfig
menu "Watchdog teaching demo"
    config DEMO_WDT_FAULT
        bool "Inject a busy loop after three healthy iterations"
        default n
        help
            Intentionally starve CPU0 for six seconds. TWDT panics after
            three seconds. Disable this option to run the repaired version.
endmenu
```

## examples/08-task-watchdog/sdkconfig.defaults
```kconfig
# DNESP32S3：芯片与 Flash 容量；不复用其他工程生成的 sdkconfig。
CONFIG_IDF_TARGET="esp32s3"
CONFIG_ESPTOOLPY_FLASHSIZE_16MB=y
CONFIG_FREERTOS_HZ=1000
# 本课在 app_main 中配置任务看门狗。
CONFIG_ESP_TASK_WDT_INIT=n
```

## examples/12-key-breathing-modes/sdkconfig.defaults
```kconfig
# DNESP32S3：芯片与 Flash 容量；不复用其他工程生成的 sdkconfig。
CONFIG_IDF_TARGET="esp32s3"
CONFIG_ESPTOOLPY_FLASHSIZE_16MB=y
CONFIG_FREERTOS_HZ=1000
```

## 资料/05-beep-xl9555/sdkconfig.defaults
```kconfig
CONFIG_IDF_TARGET="esp32s3"
CONFIG_ESPTOOLPY_FLASHSIZE_16MB=y
CONFIG_ESPTOOLPY_FLASHSIZE="16MB"
CONFIG_PARTITION_TABLE_CUSTOM=y
CONFIG_PARTITION_TABLE_CUSTOM_FILENAME="partitions-16Mib.csv"
CONFIG_PARTITION_TABLE_FILENAME="partitions-16Mib.csv"
CONFIG_SPIRAM=y
CONFIG_SPIRAM_MODE_OCT=y
CONFIG_SPIRAM_TYPE_AUTO=y
CONFIG_SPIRAM_CLK_IO=30
CONFIG_SPIRAM_CS_IO=26
CONFIG_SPIRAM_SPEED_80M=y
CONFIG_SPIRAM_SPEED=80
CONFIG_SPIRAM_BOOT_HW_INIT=y
CONFIG_SPIRAM_BOOT_INIT=y
CONFIG_SPIRAM_USE_MALLOC=y
CONFIG_SPIRAM_MEMTEST=y
CONFIG_SPIRAM_MALLOC_ALWAYSINTERNAL=16384
CONFIG_SPIRAM_MALLOC_RESERVE_INTERNAL=32768
CONFIG_ESP_SLEEP_PSRAM_LEAKAGE_WORKAROUND=y
```

## 资料/06-ble-control-car/ESP32：ble-control-car/main/Kconfig.projbuild
```kconfig
menu "Car Config Example"

    config MOTOR_A_IN1
        int 'The Motor 1 pin.'
        default 7
        help
            Motor 1 pin.

    config MOTOR_A_IN2
        int 'The Motor 2 pin.'
        default 6
        help
            Motor 2 pin.

    config MOTOR_B_IN3
        int 'The Motor 3 pin.'
        default 5
        help
            Motor 4 pin.

    config MOTOR_B_IN4
        int 'The Motor 4 pin.'
        default 4
        help
            Motor 4 pin.

    config KEY_SETUP
        bool 'Enable The WiFi Configuration Button.'
        default y
        help
            If enabled, long press for LONG_PRESS_TIME seconds to enter the network configuration mode.

    config KEY_PIN
        int 'The Configuration Button pin.'
        default 12
        help
            The Configuration Button pin.

    config LONG_PRESS_TIME
        int 'The Configuration Button Long press time(s).'
        default 3
        help
            The Configuration Button Long press time.

    config LED_SETUP
        bool 'Enable the LED.'
        default y
        help
            If enabled, the green indicator light will illuminate for successful MQTT connection, and the blue indicator light will illuminate for AP WiFi network configuration.

    choice BOARD_TYPE
        prompt "Types of Development Boards"
        default BOARD_TYPE_S3
        help
            Types of Development Boards.

        config BOARD_TYPE_S3
            bool "ESP32-S3"
        config BOARD_TYPE_C3
            bool "ESP32-C3"
    endchoice

    if BOARD_TYPE_S3
    config LED_PIN
        int 'The LED pin.'
        default 48
        help
            The LED pin.

    config MAX_LEDS
        int 'Maximum number of LEDs.'
        default 1
        help
            Maximum number of LEDs.
    endif

    if BOARD_TYPE_C3
    config LED_PIN1
        int 'The LED1 pin.'
        default 12
        help
            The LED1 pin.
    config LED_PIN2
        int 'The LED2 pin.'
        default 13
        help
            The LED2 pin.
    endif

endmenu
```
